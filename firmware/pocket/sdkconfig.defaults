## firmware/pocket/sdkconfig.defaults
```kconfig
CONFIG_EXAMPLE_MODE_ECHO=y
CONFIG_EXAMPLE_VOICE_VOLUME=80
CONFIG_MIC_GAIN_24DB=y

# Flash — Waveshare ESP32-S3 AMOLED 1.8 has 16 MB but 4 MB is plenty for us.
# LVGL pushes app binary over the default 1 MB single-app layout.
CONFIG_ESPTOOLPY_FLASHSIZE_4MB=y
CONFIG_ESPTOOLPY_FLASHMODE_QIO=y
CONFIG_PARTITION_TABLE_CUSTOM=y
CONFIG_PARTITION_TABLE_CUSTOM_FILENAME="partitions.csv"
CONFIG_PARTITION_TABLE_FILENAME="partitions.csv"

# PSRAM — Waveshare ESP32-S3 AMOLED 1.8 has 8MB OCT PSRAM.
# Needed for large rx ringbuffer (bridge_ws.c allocates 512KB from PSRAM).
CONFIG_SPIRAM=y
CONFIG_SPIRAM_MODE_OCT=y
CONFIG_SPIRAM_TYPE_AUTO=y
CONFIG_SPIRAM_SPEED_80M=y
CONFIG_SPIRAM_BOOT_INIT=y
CONFIG_SPIRAM_USE_MALLOC=y
CONFIG_SPIRAM_FETCH_INSTRUCTIONS=y
CONFIG_SPIRAM_RODATA=y

# Perf
CONFIG_COMPILER_OPTIMIZATION_PERF=y
CONFIG_ESP_DEFAULT_CPU_FREQ_MHZ_240=y
CONFIG_ESP32S3_DATA_CACHE_LINE_64B=y
CONFIG_FREERTOS_HZ=1000

# LVGL — 16bpp RGB565 with byte-swap for SH8601 QSPI.
CONFIG_LV_COLOR_DEPTH_16=y
CONFIG_LV_COLOR_16_SWAP=y
CONFIG_LV_DISP_DEF_REFR_PERIOD=30
CONFIG_LV_MEM_CUSTOM=y
CONFIG_LV_MEMCPY_MEMSET_STD=y
CONFIG_LV_ATTRIBUTE_FAST_MEM_USE_IRAM=y
```
